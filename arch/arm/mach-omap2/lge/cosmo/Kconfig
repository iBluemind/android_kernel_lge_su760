## arch/arm/mach-omap2/lge/cosmo/Kconfig
```kconfig
#
# LGE P940
#

config MACH_LGE_COSMO
	bool "LGE COSMO board"
	select HIGHMEM
	select TWL6030_PWM
	select TWL6030_GPADC
	select MISC_DEVICES
	select STAGING
	select IIO
	select HWMON
	select INPUT_MISC
	select INPUT_KEYBOARD
	select INPUT_TOUCHSCREEN
	select POWER_SUPPLY
	select TWL6030_BCI_BATTERY
#	select SECURITY_MIDDLEWARE_COMPONENT
	select CDC_TCXO
	select INPUT_TWL6030_PWRBUTTON
	select OMAP_REBOOT_REASON

config INPUT_LGE_ANDROID_3KEYS
	bool "LGE COSMO Android 3kyes for korea domestic board"
	depends on MACH_LGE_COSMO

config MACH_LGE_COSMO_P920
	bool "LGE COSMO P920 board"
	depends on MACH_LGE_COSMO
	default y

config MACH_LGE_COSMO_SU760
	bool "LGE COSMO SU760 board"
	depends on MACH_LGE_COSMO

config MACH_LGE_COSMO_3D_DISPLAY
	bool "LGE COSMO SU760 board"
	depends on MACH_LGE_COSMO
	default y
config COSMO_ICS_MEM_OPT
	bool "LGE COSMO SU760 board"
	depends on MACH_LGE_COSMO
	default y
```

## drivers/cosmo/Kconfig
```kconfig
# drivers/cosmo/Kconfig

menuconfig LGE_COSMO_DRIVERS
	bool "LGE Cosmopolitan"
	default y
	---help---
		Support for LG P920 Drivers.
		
if LGE_COSMO_DRIVERS
source "drivers/cosmo/muic/Kconfig"
source "drivers/cosmo/charger/Kconfig"
source "drivers/cosmo/fuel_gauge/Kconfig"
#source "drivers/cosmo/audio/Kconfig"
source "drivers/cosmo/subpmic/Kconfig"
source "drivers/cosmo/misc/Kconfig"
source "drivers/cosmo/mtc_eta/Kconfig"
source "drivers/cosmo/mhl/Kconfig"
endif #LG_FW_DRIVERS
```

## drivers/cosmo/charger/Kconfig
```kconfig
config LG_FW_RT9524_CHARGER
	bool "RT9524_CHARGER"
	default n
	help
	  Support for RT9524_CHARGER driver. 

config LG_FW_MAX17040_FUEL_GAUGE
	bool "MAX17040_FUEL_GAUGE"
	default n
	help
	  Support for MAX17040_FUEL_GAUGE driver. 
```

## drivers/cosmo/fuel_gauge/Kconfig
```kconfig
config LG_FW_MAX17043_FUEL_GAUGE
	bool "MAX17043_FUEL_GAUGE"
	default n
	help
	  Support for MAX17043_FUEL_GAUGE driver.

choice
	prompt "Choose the LG_FW_MAX17043_FUEL_GAUGE BUS"
	depends on LG_FW_MAX17043_FUEL_GAUGE
	default LG_FW_MAX17043_FUEL_GAUGE_GPIO

config LG_FW_MAX17043_FUEL_GAUGE_I2C
	bool "MAX17043_FUEL_GAUGE_I2C"
	depends on LG_FW_MAX17043_FUEL_GAUGE
	help
	  Support for MAX17043_FUEL_GAUGE I2C  driver.

config LG_FW_MAX17043_FUEL_GAUGE_GPIO
	bool "MAX17043_FUEL_GAUGE_GPIO"
	depends on LG_FW_MAX17043_FUEL_GAUGE
	help
	  Support for MAX17043_FUEL_GAUGE GPIO driver.

endchoice
```

## drivers/cosmo/mhl/Kconfig
```kconfig
config CX2_MHL_TX_SII9244
	bool "CONFIG_CX2_MHL_TX_SII9244"
	default n
	help
	  Support for SII9244 MHL driver.
```

## drivers/cosmo/misc/Kconfig
```kconfig
config SENSORS_APDS9900
	bool "Avago APDS9900 sensor"
	default n
        help
          If you say yes here you get support for the Avago APDS9900
          ambient light + proximity sensor.

config COSMO_VIBRATOR
	bool "Vibrator"
	default y
	help
	  Linear vibrator runs with OMAP-PWM

config	COSMO_KEYPAD_LEDS
	bool "keypad led driver"
	select NEW_LEDS
	select LEDS_CLASS	
	help
	if you say yes here get driver support for the omap keypad backlight

config BACKLIGHT_LM3528
	bool "Backlight Driver for LM3528"
	depends on BACKLIGHT_CLASS_DEVICE
	select SUBPMIC_LM3528
	help
	  If you have a LCD backlight connected to the MAIN and(or) SUB/FB output of
	  LM3528, say Y here to enable this driver.
	  To compile this driver as a module, choose M here: the module will
	  be called lm3528_bl.
	  	
config BACKLIGHT_LM3530
    bool "Backlight Driver for LM3530"
    depends on BACKLIGHT_CLASS_DEVICE
    select SUBPMIC_LM3530
    help
        If you have a LCD backlight connected to the brightness output of
        LM3530, say Y here to enable this driver.
        To compile this driver as a module, choose M here: the module will
        be called lm3528_bl.
	  	
config COSMO_CAMERAFLASH_LM3559
	bool "flash driver for lm3559"
	default y
	help
	This is a flash driver for lm3559.
```

## drivers/cosmo/mtc_eta/Kconfig
```kconfig
config LGE_MTC_ETA
      bool "Support LGE MTC_ETA Event (Key, Touch) Logging"
      default n
      depends on MACH_LGE_COSMOPOLITAN
      help
         LGE MTC/ETA
```

## drivers/cosmo/muic/Kconfig
```kconfig
config LGE_COSMO_MUIC
	bool "Comopolitan MUIC"
	depends on MACH_LGE_COSMOPOLITAN
	help
	  Support for MUIC Driver

config LGE_CX2_MUIC
	bool "CX2 MUIC"
	depends on MACH_LGE_CX2
	help
	  Support for MUIC Driver

config LG_FW_MUIC_CONTROL_E920
	bool "MUIC - P350,C550 MUIC CONTROL"
	depends on LG_FW_MUIC_MAX14526
	help
	  support to control muic
```

## drivers/cosmo/subpmic/Kconfig
```kconfig
# drivers/cosmo/Kconfig


config SUBPMIC_LP8720
	bool "SUB PMIC LP8720"
	default n
	#depends on MACH_LGE_COSMO_REV_A || MACH_LGE_COSMO_REV_A2
	help
	  Support for LP8720 SUB PMIC driver.

config SUBPMIC_RT8053
	bool "SUB PMIC RT8053"
	default n
	help
	  Support for RT8053 SUB PMIC driver.

config SUBPMIC_LM3528
	bool "Backlight driver for LM3528 using OLED"
	default n
	help
	  If you have a LCD backlight connected to the MAIN and(or) SUB/FB output of
	  LM3528, say Y here to enable this driver.
	  To compile this driver as a module, choose M here: the module will
	  be called lm3528_bl.

config SUBPMIC_LM3530
        bool "Backlight driver for LM3528 using OLED"
        default n
        help
            If you have a LCD backlight connected to the brightness output of
            LM3530, say Y here to enable this driver.
            To compile this driver as a module, choose M here: the module will
            be called lm3530_bl.
```

## drivers/nfc/Kconfig
```kconfig
menu "NFC(Near Field Communication) support"

config NFC_PN544 
	bool "PN544 - NFC controller"
	default n
	help
	  Say 'Y' to support NFC controller, NXP NFC controller "PN544"

endmenu
```

## drivers/video/omap2/displays/Kconfig
```kconfig
menu "OMAP2/3 Display Device Drivers"
        depends on OMAP2_DSS

config PANEL_GENERIC
        tristate "Generic Panel"
        help
	  Generic panel driver.
	  Used for DVI output for Beagle and OMAP3 SDP.

config PANEL_SAMSUNG_LTE430WQ_F0C
        tristate "Samsung LTE430WQ-F0C LCD Panel"
        depends on OMAP2_DSS
        help
          LCD Panel used on Overo Palo43

config PANEL_SHARP_LS037V7DW01
        tristate "Sharp LS037V7DW01 LCD Panel"
        depends on OMAP2_DSS
        help
          LCD Panel used in TI's SDP3430 and EVM boards

config PANEL_PICO_DLP
	tristate "OMAP PICO DLP Panel"
	depends on OMAP2_DSS
	help
	LCD Panel used in TI's SDP4430 and EVM boards

config PANEL_TAAL
        tristate "Taal DSI Panel"
        depends on OMAP2_DSS_DSI
        help
          Taal DSI command mode panel from TPO.

config PANEL_SHOLES
        tristate "Sholes Panel"
        help
	  LCD Panel used in sholes

config LCD_4430SDP
        tristate "OMAP4 LCD Panel"
        help
          LCD Panel used in OMAP4

config PANEL_NEC
	tristate "NEC Panel"
	help
		LCD Panel used in the Zoom board
config PANEL_HUB
       tristate "OMAP4 Hub LCD Panel"
       help
	  LCD Panel used for LGE cosmopolitan evb board   
config PANEL_SIL9022
	tristate "HDMI interface"
	help
		HDMI interface used in the Zoom board
config PANEL_COSMO
       tristate "OMAP4 Cosmopolitan 3D LCD Panel"
       help
	  LCD Panel used for LGE cosmopolitan board   

config PANEL_LH430WV1_SD02
    tristate "justin panel(LH430WV1-SD02) LG4572 driver IC"
    default n
    help
    This is the justin panel(LH430WV1-SD02) LG4572 driver IC

config PANEL_LH430WV4_SD02
    tristate "B2 Rev.A panel(LH430WV4-SD02) LG4574 driver IC"
    default n
    help
        This is the B2 Rev.A panel(LH430WV4-SD02) LG4574 driver IC
        
config PANEL_LH430WV5_SD01
    tristate "CX2 Rev.A panel(LH430WV5-SD01) LG4574 driver IC"
    default n
    help
        This is the CX2 Rev.A panel(LH430WV5-SD01) LG4574 driver IC
        
config PANEL_TX11D101VM_0EAA
    tristate "B2 Korea and Docomo panel(TX11D101VM_0EAA) LG4574 driver IC"
    default n
    help
        This is the B2 Korea and Docomo HITACHI panel(TX11D101VM_0EAA) LG4574 driver IC

endmenu
```
